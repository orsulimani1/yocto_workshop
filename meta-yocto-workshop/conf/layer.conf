## meta-yocto-workshop/conf/layer.conf
```bitbake
# We have a conf and classes directory, add to BBPATH
BBPATH .= ":${LAYERDIR}"

# We have recipes-* directories, add to BBFILES
BBFILES += "${LAYERDIR}/recipes-*/*/*.bb \
	${LAYERDIR}/recipes-*/*/*.bbappend"

BBFILE_COLLECTIONS += "yocto-workshop"
BBFILE_PATTERN_yocto-workshop = "^${LAYERDIR}/"
BBFILE_PRIORITY_yocto-workshop = "5"

LAYERSERIES_COMPAT_yocto-workshop = "kirkstone"
```
